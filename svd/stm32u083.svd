# STM32U083 register map
File version: 1.0
CPU: CM0+ r0p1, little endian, MPU, no FPU, 4 interrupt priority bits
Registers are 32-bit, read-write, reset 0x0 unless marked. A register's access mark holds for its fields unless they carry their own. Offsets are from the block's base; lines under a group give offsets from that group; [hi:lo] are bit positions; {n}, {i} and the like mark numbered series; 'fields as' and 'values as' point back to an identical list; <NAME> marks a mode.

## Memory map
0x40000000 TIM2 size 0x6C — TIM2 address block description
0x40000400 TIM3 size 0x6C — TIM3 address block description
0x40001000 TIM6 size 0x30 — TIM6 address block description
0x40001400 TIM7 size 0x30 — TIM7 address block description
0x40002400 LCD size 0x54 — LCD address block description
0x40002800 RTC size 0x400 — RTC register block
0x40002C00 WWDG size 0xC — WWDG address block description
0x40003000 IWDG size 0x18 — IWDG address block description
0x40003800 SPI2 size 0x400
0x40003C00 SPI3 size 0x400
0x40004400 USART2 size 0x30
0x40004800 USART3 size 0x30
0x40004C00 USART4 size 0x30
0x40005400 I2C1 size 0x2C — I2C address block description
0x40005800 I2C2 size 0x2C
0x40005C00 USB size 0x5C — USB address block description
0x40006C00 CRS size 0x10 — CRS address block description
0x40007000 PWR size 0x400 — PWR register block
0x40007400 DAC size 0x50 — DAC address block description
0x40007800 OPAMP size 0xC — OPAMP address block description
0x40007C00 LPTIM1 size 0x400 — LPTIM1 address block description
0x40008000 LPUART1 size 0x30 — LPUART address block description
0x40008400 LPUART2 size 0x30
0x40008800 I2C3 size 0x2C
0x40008C00 LPUART3 size 0x30
0x40009000 LPTIM3 size 0x400 — LPTIM3 address block description
0x40009400 LPTIM2 size 0x400 — LPTIM2 address block description
0x4000B000 TAMP size 0x400 — TAMP register block
0x40010000 SYSCFG size 0x400 — SYSCFG register block
0x40010030 VREFBUF size 0x8 — VREFBUF address block description
0x40010200 COMP size 0x8 — COMP address block description
0x40012400 ADC size 0x30C — ADC address block description
0x40012C00 TIM1 size 0x6C — TIM1 address block description
0x40013000 SPI1 size 0x400 — SPI address block description
0x40013800 USART1 size 0x30 — USART address block description
0x40014000 TIM15 size 0x6C — TIM15 address block description
0x40014400 TIM16 size 0x6C — TIM16 address block description
0x40015800 DBGMCU size 0x1000 — DBGMCU register block
0x40020000 DMA1 size 0x400 — DMA register bank
0x40020400 DMA2 size 0x400
0x40020800 DMAMUX size 0x148 — DMAMUX address block description
0x40021000 RCC size 0x9C — RCC address block description
0x40021800 EXTI size 0x400 — EXTI register block
0x40022000 FLASH size 0x400 — Mamba FLASH register block
0x40023000 CRC size 0x18 — CRC address block description
0x40024000 TSC size 0x50 — TSC address block description
0x40025000 RNG size 0x14 — RNG address block description
0x40026000 AES size 0x400 — AES register block
0x50000000 GPIOA size 0x2C — GPIOA address block description
0x50000400 GPIOB size 0x2C — GPIOB address block description
0x50000800 GPIOC size 0x2C — GPIOC address block description
0x50000C00 GPIOD size 0x2C — GPIOD address block description
0x50001000 GPIOE size 0x2C — GPIOE address block description
0x50001400 GPIOF size 0x2C — GPIOF address block description

## Interrupts
0 WWDG — Window watchdog interrupt
1 PVD_PVM (EXTI) — PVD/PVM1/PVM2/PVM3 interrupt (combined with EXTI lines 16 and 19 and 20 and 21)
2 RTC_TAMP (RTC) — RTC and TAMP interrupts(combined EXTI lines 19 and 21)
3 FLASH — FLASH global interrupt
4 RCC_CRS (RCC) — RCC and CRS global interrupt
5 EXTI0_1 (EXTI) — EXTI lines 0 and 1 interrupt
6 EXTI2_3 (EXTI) — EXTI lines 2 and 3 interrupt
7 EXTI4_15 (EXTI) — EXTI lines 4 to 15 interrupt
8 USB — USB global interrupt (combined with EXTI line 33)
9 DMA1_CHannel1 (DMA1) — DMA1 channel 1 interrupt
10 DMA1_Channel2_3 (DMA1) — DMA1 channel 2 and 3 interrupts
11 DMA1_Channel4_5_6_7 (DMA1) — DMA1 channel 4, 5, 6, 7, DMAMUX, DMA2 channel 1, 2, 3, 4, 5 interrupts
12 ADC_COMP (ADC) — ADC and COMP interrupts (ADC combined with EXTI lines 17 and 18)
13 TIM1_BRK_UP_TRG_COM (TIM1) — TIM1 break, update, trigger and commutation interrupts
14 TIM1_CC (TIM1) — TIM1 Capture Compare interrupt
15 TIM2 — TIM2 global interrupt
16 TIM3 — TIM3 global interrupt
17 TIM6_DAC_LPTIM1 (TIM6) — TIM6, LPTIM1 and DAC global interrupt (combined with EXTI line 29)
18 TIM7_LPTIM2 (TIM7) — TIM7 and LPTIM2 global interrupt (combined with EXTI line 30)
19 TIM15_LPTIM3 (TIM15) — TIM15 and LPTIM3 global interrupt (combined with EXTI line 29)
20 TIM16 — TIM16 global interrupt
21 TSC — TSC global interrupt
22 LCD — LCD global interrupt (combined with EXTI line 32)
23 I2C1 — I2C1 global interrupt (combined with EXTI line 23)
24 I2C2_I2C3_I2C4 (I2C2) — I2C2/3/4 global interrupt
25 SPI1 — SPI1 global interrupt
26 SPI2_SPI3 (SPI2) — SPI2/3 global interrupt
27 USART1 — USART1 global interrupt (combined with EXTI line 25)
28 USART2_LPUART2 (USART2) — USART2 and LPUART2 global interrupt (combined with EXTI lines 26 and 35)
29 USART3_LPUART1 (USART3) — USART3 and LPUART1 global interrupt (combined with EXTI lines 24 and 28)
30 USART4_LPUART3 (USART4) — USART4 and LPUART3 global interrupt (combined with EXTI lines 20 and 34)
31 AES_RNG (AES) — AES and RNG global interrupts
