# STM32H735 register map
File version: 1.2
CPU: CM7 r0p1, little endian, MPU, FPU, 4 interrupt priority bits
Registers are 32-bit, read-write, reset 0x0 unless marked. A register's access mark holds for its fields unless they carry their own. Offsets are from the block's base; lines under a group give offsets from that group; [hi:lo] are bit positions; {n}, {i} and the like mark numbered series; 'fields as' and 'values as' point back to an identical list; <NAME> marks a mode.

## Memory map
0x40000000 TIM2 size 0x400 — General purpose timers
0x40000400 TIM3 size 0x400 — General purpose timers
0x40000800 TIM4 size 0x400
0x40000C00 TIM5 size 0x400
0x40001000 TIM6 size 0x400 — Basic timers
0x40001400 TIM7 size 0x400
0x40001800 TIM12 size 0x400 — General purpose timers
0x40001C00 TIM13 size 0x400 — General purpose timers
0x40002000 TIM14 size 0x400
0x40002400 LPTIM1 size 0x400 — Low power timer
0x40003800 SPI2 size 0x400
0x40003C00 SPI3 size 0x400
0x40004000 SPDIFRX size 0x400 — Receiver Interface
0x40004400 USART2 size 0x400
0x40004800 USART3 size 0x400
0x40004C00 UART4 size 0x400
0x40005000 UART5 size 0x400
0x40005400 I2C1 size 0x400 — I2C
0x40005800 I2C2 size 0x400
0x40005C00 I2C3 size 0x400
0x40006400 I2C5 size 0x400
0x40006C00 CEC size 0x400
0x40007400 DAC size 0x400
0x40007800 UART7 size 0x400
0x40007C00 UART8 size 0x400
0x40008400 CRS size 0x400 — Clock Recovery System
0x40008800 SWPMI size 0x400 — Single Wire Protocol Master Interface
0x40009000 OPAMP size 0x400 — Operational amplifiers
0x40009400 MDIOS size 0x400 — Management data input/output slave
0x4000A000 FDCAN1 size 0x400
0x4000A400 FDCAN2 size 0x400
0x4000A800 CAN_CCU size 0x400 — CCU registers
0x4000D400 FDCAN3 size 0x400
0x4000E000 TIM23 size 0x400
0x4000E400 TIM24 size 0x400
0x40010000 TIM1 size 0x400 — Advanced-timers
0x40010400 TIM8 size 0x400
0x40011000 USART1 size 0x400 — Universal synchronous asynchronous receiver transmitter
0x40011400 USART6 size 0x400
0x40011800 UART9 size 0x400
0x40011C00 USART10 size 0x400
0x40013000 SPI1 size 0x400 — Serial peripheral interface
0x40013400 SPI4 size 0x400
0x40014000 TIM15 size 0x400 — General purpose timers
0x40014400 TIM16 size 0x400 — General-purpose-timers
0x40014800 TIM17 size 0x400 — General-purpose-timers
0x40015000 SPI5 size 0x400
0x40015800 SAI1 size 0x400 — SAI
0x40017800 DFSDM size 0x400 — Digital filter for sigma delta modulators
0x40020000 DMA1 size 0x400 — DMA controller
0x40020400 DMA2 size 0x400
0x40020800 DMAMUX1 size 0x400 — DMAMUX
0x40022000 ADC1 size 0x100 — Analog to Digital Converter
0x40022100 ADC2 size 0x100
0x40022300 ADC12_Common size 0x100 — Analog-to-Digital Converter
0x40028000 Ethernet_MAC size 0x1400 — Ethernet: media access control (MAC)
0x40028C00 Ethernet_MTL
0x40029000 Ethernet_DMA
0x40040000 OTG1_HS_GLOBAL size 0x3FFFF — USB 1 on the go high speed
0x40040400 OTG1_HS_HOST size 0x400 — USB 1 on the go high speed
0x40040800 OTG1_HS_DEVICE size 0x400 — USB 1 on the go high speed
0x40040E00 OTG1_HS_PWRCLK size 0x3F200 — USB 1 on the go high speed
0x40080400 OTG2_HS_HOST size 0x400
0x40080800 OTG2_HS_DEVICE size 0x400
0x40080E00 OTG2_HS_PWRCLK size 0x3F200
0x48020000 DCMI size 0x400 — Digital camera interface
0x48020400 PSSI size 0x400 — PSSI register block
0x48021000 CRYP size 0x400 — Cryptographic processor
0x48021800 RNG size 0x400
0x48022400 SDMMC2 size 0x1000
0x48022800 DELAY_Block_SDMMC2 size 0x400
0x48023000 RAMECC2 size 0x1000 — ECC controller is associated to each RAM area
0x48024000 FMAC size 0x400 — FMAC register block
0x48024400 CORDIC size 0x100 — CORDIC register block
0x50001000 LTDC size 0x1000 — LCD-TFT Controller
0x50003000 WWDG1 size 0x1000 — WWDG
0x51000000 AXI size 0x100000 — AXI interconnect registers
0x52000000 MDMA size 0x1000
0x52001000 DMA2D size 0x400
0x52002000 FLASH size 0x1000
0x52004000 FMC size 0x400
0x52005000 OCTOSPI1 size 0x1000 — OctoSPI
0x52006000 Delay_Block_OCTOSPI1 size 0x400
0x52007000 SDMMC1 size 0x1000
0x52008000 DELAY_Block_SDMMC1 size 0x400
0x52009000 RAMECC1 size 0x1000 — ECC controller is associated to each RAM area
0x5200A000 OCTOSPI2 size 0x1000
0x5200B000 Delay_Block_OCTOSPI2 size 0x400
0x5200B400 OctoSPII_O_Manager size 0x400
0x5200B800 OTFDEC1 size 0x30C — OTFDEC address block description
0x5200BC00 OTFDEC2 size 0x30C
0x58000000 EXTI size 0x400 — External interrupt/event controller
0x58000400 SYSCFG size 0x400 — System configuration controller
0x58000C00 LPUART1 size 0x400
0x58001400 SPI6 size 0x400
0x58001C00 I2C4 size 0x400
0x58002400 LPTIM2 size 0x400
0x58002800 LPTIM3 size 0x400 — Low power timer
0x58002C00 LPTIM4 size 0x400
0x58003000 LPTIM5 size 0x400
0x58003800 COMP1 size 0x400
0x58003C00 VREFBUF size 0x400
0x58004000 RTC size 0x400
0x58004800 IWDG1 size 0x400 — IWDG
0x58005400 SAI4 size 0x400
0x58020000 GPIOA size 0x400 — GPIO
0x58020400 GPIOB size 0x400 — GPIO
0x58020800 GPIOC size 0x400 — GPIO
0x58020C00 GPIOD size 0x400
0x58021000 GPIOE size 0x400
0x58021400 GPIOF size 0x400
0x58021800 GPIOG size 0x400
0x58021C00 GPIOH size 0x400
0x58022400 GPIOJ size 0x400 — GPIO
0x58022800 GPIOK size 0x400 — GPIO
0x58024400 RCC size 0x400 — Reset and clock control
0x58024800 PWR size 0x400
0x58024C00 CRC size 0x400 — Cryptographic processor
0x58025400 BDMA size 0x400
0x58025800 DMAMUX2 size 0x400 — DMAMUX
0x58026000 ADC3 size 0x400 — Analog-to-Digital Converter
0x58026300 ADC3_Common size 0x400 — Analog-to-Digital Converter
0x58026400 HSEM size 0x400
0x58027000 RAMECC3 size 0x1000 — ECC controller is associated to each RAM area
0x5C001000 DBGMCU size 0x400 — Microcontroller Debug Unit

## Interrupts
0 WWDG1 — Window Watchdog interrupt
1 PVD_PVM (EXTI) — PVD through EXTI line
2 RTC_TAMP_STAMP_CSS_LSE (RTC) — RTC tamper, timestamp
3 RTC_WKUP (RTC) — RTC Wakeup interrupt
4 FLASH — Flash memory
5 RCC — RCC global interrupt
6 EXTI0 (EXTI) — EXTI Line 0 interrupt
7 EXTI1 (DELAY_Block_SDMMC1, EXTI) — EXTI Line 1 interrupt
8 EXTI2 (EXTI) — EXTI Line 2 interrupt
9 EXTI3 (EXTI) — EXTI Line 3interrupt
10 EXTI4 (EXTI) — EXTI Line 4interrupt
11 DMA_STR0 (DMA1) — DMA1 Stream0
12 DMA_STR1 (DMA1) — DMA1 Stream1
13 DMA_STR2 (DMA1) — DMA1 Stream2
14 DMA_STR3 (DMA1) — DMA1 Stream3
15 DMA_STR4 (DMA1) — DMA1 Stream4
16 DMA_STR5 (DMA1) — DMA1 Stream5
17 DMA_STR6 (DMA1) — DMA1 Stream6
18 ADC1_2 (ADC12_Common) — ADC1 and ADC2
19 FDCAN1_IT0 (FDCAN1) — FDCAN1 Interrupt 0
20 FDCAN2_IT0 (FDCAN2) — FDCAN2 Interrupt 0
21 FDCAN1_IT1 (FDCAN1) — FDCAN1 Interrupt 1
22 FDCAN2_IT1 (FDCAN2) — FDCAN2 Interrupt 1
23 EXTI9_5 (EXTI) — EXTI Line[9:5] interrupts
24 TIM1_BRK (TIM1) — TIM1 break interrupt
25 TIM1_UP (TIM1) — TIM1 update interrupt
26 TIM1_TRG_COM (TIM1) — TIM1 trigger and commutation
27 TIM1_CC (TIM1) — TIM1 capture / compare
28 TIM2 — TIM2 global interrupt
29 TIM3 — TIM3 global interrupt
30 TIM4 — TIM4 global interrupt
31 I2C1_EV (I2C1) — I2C1 event interrupt
32 I2C1_ER (I2C1) — I2C1 global error interrupt
33 I2C2_EV (I2C2) — I2C2 event interrupt
34 I2C2_ER (I2C2) — I2C2 global error interrupt
35 SPI1 — SPI1 global interrupt
36 SPI2 — SPI2 global interrupt
37 USART1 — USART1 global interrupt
38 USART2 — USART2 global interrupt
39 USART3 — USART3 global interrupt
40 EXTI15_10 (EXTI) — EXTI Line[15:10] interrupts
41 RTC_ALARM (RTC) — RTC alarms (A and B)
43 TIM8_BRK_TIM12 (TIM8) — TIM8 and 12 break global
44 TIM8_UP_TIM13 (TIM8) — TIM8 and 13 update global
45 TIM8_TRG_COM_TIM14 (TIM8) — TIM8 and 14 trigger /commutation and global
46 TIM8_CC (TIM8) — TIM8 capture / compare
47 DMA1_STR7 (DMA1) — DMA1 Stream7
48 FMC — FMC global interrupt
49 SDMMC1 — SDMMC1 global interrupt
50 TIM5 — TIM5 global interrupt
51 SPI3 — SPI3 global interrupt
52 UART4 — UART4 global interrupt
53 UART5 — UART5 global interrupt
54 TIM6_DAC (TIM6) — TIM6 global interrupt
55 TIM7 — TIM7 global interrupt
56 DMA2_STR0 (DMA2) — DMA2 Stream0 interrupt
57 DMA2_STR1 (DMA2) — DMA2 Stream1 interrupt
58 DMA2_STR2 (DMA2) — DMA2 Stream2 interrupt
59 DMA2_STR3 (DMA2) — DMA2 Stream3 interrupt
60 DMA2_STR4 (DMA2) — DMA2 Stream4 interrupt
61 ETH (Ethernet_MAC) — Ethernet global interrupt
62 ETH_WKUP (Ethernet_MAC) — Ethernet wakeup through EXTI
63 FDCAN_CAL (FDCAN1) — CAN2TX interrupts
68 DMA2_STR5 (DMA2) — DMA2 Stream5 interrupt
69 DMA2_STR6 (DMA2) — DMA2 Stream6 interrupt
70 DMA2_STR7 (DMA2) — DMA2 Stream7 interrupt
71 USART6 — USART6 global interrupt
72 I2C3_EV (I2C3) — I2C3 event interrupt
73 I2C3_ER (I2C3) — I2C3 error interrupt
74 OTG_HS_EP1_OUT (OTG1_HS_DEVICE, OTG1_HS_GLOBAL) — USB OTG_HS OUT endpoint1 global interrupt
75 OTG_HS_EP1_IN (OTG1_HS_DEVICE, OTG1_HS_GLOBAL) — USB OTG_HS IN endpoint1 global interrupt
76 OTG_HS_WKUP (OTG1_HS_DEVICE, OTG1_HS_GLOBAL) — USB OTG_HS wakeup Interrupt through EXTI linet
77 OTG_HS (OTG1_HS_DEVICE, OTG1_HS_GLOBAL) — USB OTG_HS global interrupt
78 DCMI_PSSI (DCMI) — DCMI/PSSI global interrupt
79 CRYP — Crypto global interrupt
80 HASH_RNG (RNG) — HASH OR RNG interrupt
81 FPU (EXTI) — CPU FPU interrupt
82 UART7 — UART7 global interrupt
83 UART8 — UART8 global interrupt
84 SPI4 — SPI4 global interrupt
85 SPI5 — SPI5 global interrupt
86 SPI6 — SPI6 global interrupt
87 SAI1 — SAI1 global interrupt
88 LTDC — LCD-TFT global interrupt
89 LTDC_ER (LTDC) — LCD-TFT error interrupt
89 LTDC_ERR (LTDC) — LCD-TFT global Error interrupt
90 DMA2D — DMA2D global interrupt
92 OCTOSPI1 — OCTOSPI1 global interrupt
93 LPTIM1 — LPTIM1 global interrupt
94 CEC — HDMI-CEC global interrupt
95 I2C4_EV (I2C4) — I2C4 event interrupt
96 I2C4_ER (I2C4) — I2C4 error interrupt
97 SPDIF (SPDIFRX) — SPDIFRX global interrupt
102 DMAMUX1_OV (DMAMUX1) — DMAMUX1 overrun interrupt
110 DFSDM1_FLT0 (DFSDM) — DFSDM1 filter 0 interrupt
111 DFSDM1_FLT1 (DFSDM) — DFSDM1 filter 1 interrupt
112 DFSDM1_FLT2 (DFSDM) — DFSDM1 filter 2 interrupt
113 DFSDM1_FLT3 (DFSDM) — DFSDM1 filter 3 interrupt
115 SWPMI1 (SWPMI) — SWPMI global interrupt
116 TIM15 — TIM15 global interrupt
117 TIM16 — TIM16 global interrupt
118 TIM17 — TIM17 global interrupt
119 MDIOS_WKUP (MDIOS) — MDIOS wakeup
120 MDIOS — MDIOS global interrupt
122 MDMA — MDMA Global interrupt
124 SDMMC2 — SDMMC2 global interrupt
125 HSEM0 (HSEM) — HSEM global interrupt 1
127 ADC3 — ADC3 global interrupt
128 DMAMUX2_OVR (DMAMUX2) — DMAMUX2 overrun interrupt
{n+129} BDMA_CH{n} (BDMA) (n=0..7) — BDMA channel {n} interrupt
137 COMP (COMP1) — COMP1 and COMP2 global interrupt
138 LPTIM2 — LPTIM2 timer interrupt
139 LPTIM3 — LPTIM2 timer interrupt
140 LPTIM4 — LPTIM2 timer interrupt
141 LPTIM5 — LPTIM2 timer interrupt
142 LPUART (LPUART1) — LPUART global interrupt
144 CRS — Clock Recovery System global interrupt
145 ECC_DIAG_IT (RAMECC1) — ECC diagnostic global interrup
146 SAI4 — SAI4 global interrupt
147 TEMP_IT (EXTI) — Temperature sensor global interrupt
149 WKUP (EXTI) — WKUP1 to WKUP6 pins
150 OCTOSPI2 — OCTOSPI2 global interrupt
151 OTFDEC1 — OTFDEC1 interrupt
152 OTFDEC2 — OTFDEC2 interrupt
153 FMAC — FMAC interrupt
154 CORDIC_IT (CORDIC) — CORDIC interrupt
155 UART9 — UART9 interrupt
156 USART10 — USART10 interrupt
157 I2C5_EV (I2C5) — I2C5 event interrupt
158 I2C5_ER (I2C5) — I2C5 error interrupt
159 FDCAN3_IT0 (FDCAN3) — FDCAN3 Interrupt 0
160 FDCAN3_IT1 (FDCAN3) — FDCAN3 Interrupt 1
161 TIM23 — TIM23 global interrupt
162 TIM24 — TIM24 global interrupt
