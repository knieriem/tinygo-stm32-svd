# STM32F373 register map
File version: 1.7
CPU: CM4 r1p0, little endian, MPU, FPU, 4 interrupt priority bits
Registers are 32-bit, read-write, reset 0x0 unless marked. A register's access mark holds for its fields unless they carry their own. Offsets are from the block's base; lines under a group give offsets from that group; [hi:lo] are bit positions; {n}, {i} and the like mark numbered series; 'fields as' and 'values as' point back to an identical list; <NAME> marks a mode.

## Memory map
0x40000000 TIM2 size 0x400 — General purpose timer
0x40000400 TIM3 size 0x400 — General purpose timer
0x40000800 TIM4 size 0x400
0x40000C00 TIM5 size 0x400 — General purpose timer
0x40001000 TIM6 size 0x400 — Basic timers
0x40001400 TIM7 size 0x400
0x40001800 TIM12 size 0x400 — General purpose timers
0x40001C00 TIM13 size 0x400 — General purpose timers
0x40002000 TIM14 size 0x400
0x40002800 RTC size 0x400 — Real-time clock
0x40002C00 WWDG size 0x400 — Window watchdog
0x40003000 IWDG size 0x400 — Independent watchdog
0x40003400 I2S2ext size 0x400
0x40003800 SPI2 size 0x400
0x40003C00 SPI3 size 0x400
0x40004000 I2S3ext size 0x400
0x40004400 USART2 size 0x400
0x40004800 USART3 size 0x400
0x40005400 I2C1 size 0x400 — Inter-integrated circuit
0x40005800 I2C2 size 0x400
0x40005C00 USB size 0x400 — Universal serial bus full-speed device interface
0x40006400 CAN size 0x400 — Controller area network
0x40007000 PWR size 0x400 — Power control
0x40007400 DAC1 size 0x400 — Digital-to-analog converter
0x40007800 CEC size 0x400 — HDMI-CEC controller
0x40009800 DAC2 size 0x400 — Digital-to-analog converter
0x40009C00 TIM18 size 0x400
0x40010000 SYSCFG size 0x400 — System configuration controller
0x40010000 COMP size 0x400 — General purpose comparators
0x40010400 EXTI size 0x400 — External interrupt/event controller
0x40012400 ADC1 size 0x400 — Analog to digital converter
0x40013000 SPI1 size 0x400 — Serial peripheral interface/Inter-IC sound
0x40013800 USART1 size 0x400 — Universal synchronous asynchronous receiver transmitter
0x40014000 TIM15 size 0x400 — General purpose timers
0x40014400 TIM16 size 0x400 — General-purpose-timers
0x40014800 TIM17 size 0x400
0x40015C00 TIM19 size 0x400
0x40016000 SDADC1 size 0x400 — Sigma-delta analog-to-digital converter
0x40016400 SDADC2 size 0x400
0x40016800 SDADC3 size 0x400
0x40020000 DMA1 size 0x400 — DMA controller 1
0x40020400 DMA2 size 0x400
0x40021000 RCC size 0x400 — Reset and clock control
0x40022000 FLASH size 0x400
0x40023000 CRC size 0x400 — cyclic redundancy check calculation unit
0x40024000 TSC size 0x400 — Touch sensing controller
0x48000000 GPIOA size 0x400 — General-purpose I/Os
0x48000400 GPIOB size 0x400 — General-purpose I/Os
0x48000800 GPIOC size 0x400 — General-purpose I/Os
0x48000C00 GPIOD size 0x400 — General-purpose I/Os
0x48001000 GPIOE size 0x400
0x48001400 GPIOF size 0x400
0xE0042000 DBGMCU size 0x400 — Debug support

## Interrupts
0 WWDG — Window Watchdog interrupt
1 PVD (EXTI) — Power voltage detector through EXTI line detection interrupt
2 TAMP (EXTI) — Tamper and timestamp through EXTI19 line
3 RTC_WKUP (RTC) — RTC
4 FLASH — Flash global interrupt
5 RCC — RCC global interrupt
6 EXTI0 (EXTI) — EXTI Line 0 interrupt
7 EXTI1 (EXTI) — EXTI Line1 interrupt
8 EXTI2_TS (EXTI) — EXTI Line 2 and routing interface interrupt
9 EXTI3 (EXTI) — EXTI Line1 interrupt
10 EXTI4 (EXTI) — EXTI Line4 interrupt
11 DMA1_CH1 (DMA1) — DMA1 channel 1 interrupt
12 DMA1_CH2 (DMA1) — DMA1 channel 2 interrupt
13 DMA1_CH3 (DMA1) — DMA1 channel 3 interrupt
14 DMA1_CH4 (DMA1) — DMA1 channel 4 interrupt
15 DMA1_CH5 (DMA1) — DMA1 channel 5 interrupt
16 DMA1_CH6 (DMA1) — DMA1 channel 6 interrupt
17 DMA1_CH7 (DMA1) — DMA1 channel 7 interrupt
18 ADC1 — ADC1 interrupt
19 CAN_TX (CAN, USB) — USB high priority/CAN_TX interrupt
20 CAN_RXD (CAN, USB) — USB low priority/CAN_RXD interrupt
21 CAN_RXI (CAN) — CAN_RXI interrupt
22 CAN_SCE (CAN) — CAN_SCE interrupt
23 EXTI5_9 (EXTI) — EXTI Line[9:5] interrupts
24 TIM15 — Timer 15 global interrupt
25 TIM16 — Timer 16 global interrupt
26 TIM17 — Timer 17 global interrupt
27 TIM18_DAC (TIM18) — Timer 18 global interrupt/DAC3 underrun interrupt
28 TIM2 — Timer 2 global interrupt
29 TIM3 — Timer 3 global interrupt
30 TIM4 — Timer 4 global interrupt
31 I2C1_EV (EXTI, I2C1) — I2C1_EV global interrupt/EXTI Line[3:2] interrupts
32 I2C1_ER (I2C1)
33 I2C2_EV (EXTI, I2C2) — I2C2_EV global interrupt/EXTI Line[4:2] interrupts
34 I2C2_ER (I2C2)
35 SPI1 — SPI1 global interrupt
36 SPI2 — SPI2 global interrupt
37 USART1 (USART1, EXTI) — USART1 global interrupt/EXTI25 (USART1 wakeup event)
38 USART2 (USART2, EXTI) — USART2 global interrupt/EXTI26 (USART1 wakeup event)
39 USART3 (USART3, EXTI) — USART3 global interrupt/EXTI28 (USART1 wakeup event)
40 EXTI15_10 (EXTI) — EXTI Line[15:10] interrupts
41 RTC_ALARM (RTC) — RTC alarm interrupt
42 CEC — CEC interrupt
43 TIM12 — Timer 12 global interrupt
44 TIM13 — Timer 13 global interrupt
45 TIM14 — Timer 14 global interrupt
50 TIM5 — Timer 5 global interrupt
51 SPI3 — SPI3 global interrupt
54 TIM6_DAC1 (TIM6, DAC1) — TIM6 global, DAC1 Cahnnel1 and Cahnnel2 underrun error Interrupts
55 TIM7 — Timer 7 global interrupt
56 DMA2_CH1 (DMA2) — DMA2 channel interrupt
57 DMA2_CH2 (DMA2) — DMA2 channel interrupt
58 DMA2_CH3 (DMA2) — DMA2 channel interrupt
59 DMA2_CH4 (DMA2) — DMA2 channel interrupt
60 DMA2_CH5 (DMA2) — DMA2 channel interrupt
61 SDADC1 — ADC sigma delta 1 (SDADC1) global interrupt
62 SDADC2 — ADC sigma delta 2 (SDADC2) global interrupt
63 SDADC3 — ADC sigma delta 3 (SDADC3) global interrupt
64 COMP1_2_3 (COMP) — COMP1_2_3 interrupt combined with EXTI lines 21, 22
74 USB_HP (USB) — USB high priority interrupt
75 USB_LP (USB) — USB low priority interrupt
76 USB_WAKEUP (USB) — USB wakeup interrupt
78 TIM19 — Timer 19 global interrupt
81 FPU (EXTI) — Floating point unit interrupt
